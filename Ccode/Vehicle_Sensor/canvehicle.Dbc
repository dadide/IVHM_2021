VERSION "HSCAN5"

NS_ :

BS_:

BU_: Diagnostics GW Taxi_Terminal_Module Tester vector__xxx

BO_ 977 GW_HSC5_ECM_FrP12: 8 GW
 SG_ VehSpdAvgDrvnHSC5 : 54|15@0+ (0.015625,0) [0|511.984] ""  Taxi_Terminal_Module

BO_ 241 GW_HSC5_FrP02: 8 GW
 SG_ BrkPdlPos_h5HSC5 : 15|8@0+ (0.392157,0) [0|100] ""  vector__xxx
